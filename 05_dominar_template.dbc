VERSION ""

NS_ :

BS_:

BU_: ECU DASH

/*
  ---- HOW TO FILL THIS IN ----
  Each message you identified in step 3 becomes a BO_ (message) block.
  Each signal inside it becomes a SG_ (signal) line.

  BO_ <can_id_decimal> <MessageName>: <dlc_bytes> <sender_node>
   SG_ <SignalName> : <start_bit>|<length_bits>@<byte_order><sign> (<scale>,<offset>) [<min>|<max>] "<unit>" <receiver_node>

  - can_id_decimal: convert the hex ID from your log to decimal
  - start_bit: bit offset within the frame (0 = first bit of byte 0)
  - byte_order: 1 = little-endian (Intel), 0 = big-endian (Motorola) -- try 1 first
  - sign: + = unsigned, - = signed
  - scale/offset: real_value = (raw_value * scale) + offset
    Work this out by comparing raw byte values (from step 3) against a
    known reference (e.g. dash-displayed RPM) at two or more points.

  EXAMPLE (fill in your real ID/bytes once identified):
*/

BO_ 256 RPM_STATUS: 8 ECU
 SG_ EngineRPM : 0|16@1+ (1,0) [0|12000] "rpm" DASH

BO_ 512 SPEED_STATUS: 8 ECU
 SG_ VehicleSpeed : 0|8@1+ (1,0) [0|255] "km/h" DASH

BO_ 768 SWITCH_STATUS: 8 ECU
 SG_ FrontBrake : 0|1@1+ (1,0) [0|1] "" DASH
 SG_ TurnSignal : 1|2@1+ (1,0) [0|3] "" DASH

/*
  Delete the example blocks above once you've replaced them with your
  real findings. Verify with 06_decode_log.py before trusting the DBC.
*/
