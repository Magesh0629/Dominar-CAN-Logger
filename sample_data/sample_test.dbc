VERSION ""

NS_ :

BS_:

BU_: ECU DASH

BO_ 256 RPM_STATUS: 8 ECU
 SG_ EngineRPM : 0|16@1+ (0.25,0) [0|16000] "rpm" DASH
 SG_ AliveCounter : 56|4@1+ (1,0) [0|15] "" DASH

BO_ 512 SPEED_STATUS: 8 ECU
 SG_ VehicleSpeed : 0|8@1+ (1,0) [0|255] "km/h" DASH
 SG_ Gear : 8|8@1+ (1,0) [0|6] "" DASH

BO_ 768 SWITCH_STATUS: 8 ECU
 SG_ FrontBrake : 0|1@1+ (1,0) [0|1] "" DASH
 SG_ TurnSignal : 1|2@1+ (1,0) [0|3] "" DASH
